## Kconfig
```kconfig
# ==========================================
# Complex KConfig for Premake-Config Testing
# ==========================================
mainmenu "Ultra Engine v2.0 Configuration"

menu "System Settings"
    config TARGET_OS
        string "Target Operating System"
        default "windows"
        help
          Specify the OS target. Options: windows, linux, macos.

    config MULTITHREADING
        bool "Enable Multithreading"
        default y

    if MULTITHREADING
        config MAX_THREADS
            int "Maximum Thread Count"
            range 1 64
            default 8
    endif
endmenu

menu "Graphics Pipeline"
    menu "Renderer Selection"
        config RENDERER_VULKAN
            bool "Vulkan Support"
            select SHADER_COMPILER
            help
              High-performance 3D graphics and compute API.

        config RENDERER_DX12
            bool "DirectX 12 Support"
            depends on TARGET_OS = "windows"
    endmenu

    config SCREEN_RESOLUTION
        hex "Default Screen Resolution (Hex)"
        default 0x07800438
        help
          Encodes width and height into a single hex value.
endmenu

config SHADER_COMPILER
    bool
    default n
    help
      Internal toggle for shader compilation tools.

menu "Advanced Debugging"
    config DEBUG_LEVEL
        int "Debug Verbosity"
        default 1
        
    config LOG_TO_FILE
        bool "Output logs to filesystem"
        default n
endmenu
```
